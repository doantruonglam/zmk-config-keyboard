## config/west.yml
```yaml
manifest:
  remotes:
    - name: zmkfirmware
      url-base: https://github.com/zmkfirmware
    - name: doantruonglam
      url-base: https://github.com/doantruonglam
    - name: zmkfirmware-infused-kim
      url-base: https://github.com/infused-kim
    - name: zmkfirmware-petejohanson
      url-base: https://github.com/infused-kim
    - name: petejohanson
      url-base: https://github.com/petejohanson
  projects:
    - name: zmk
      remote: petejohanson
      revision: display/bongo-cat-widget
      import: app/west.yml
  self:
    path: config
```
